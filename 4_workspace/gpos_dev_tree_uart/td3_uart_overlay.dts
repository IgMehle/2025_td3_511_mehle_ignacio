/dts-v1/;
/plugin/;

/ {
    compatible = "brcm,bcm2711";

    fragment@0 {
        target = <&serial1>;     /* ESTE es el UART correcto */
        __overlay__ {
            td3_uart: td3_uart {
                compatible = "utn-fra-td3,td3_uart";
            };
        };
    };
};
