/dts-v1/;
/plugin/;

/ {
    /* Compatibilidad cruzada Pi 5 / Pi 4 / Pi 3 */
    compatible = "brcm,bcm2712", "brcm,bcm2711", "brcm,bcm2835";

    /*
     * mini-UART — serial1 — dirección 0x7e215040
     * Este UART sí expone serdev en BCM2711/2712 (Pi4/Pi5)
     */
    fragment@0 {
        target-path = "/soc/serial@7e215040";   // mini-UART (AUX UART1)

        __overlay__ {
            status = "okay";

            /* Nodo hijo serdev para tu driver */
            td3_uart: td3_uart@0 {
                compatible = "utn-fra-td3,td3_uart";
                status = "okay";
            };
        };
    };

    /* Conexión serdev del hijo al bus del UART */
    fragment@1 {
        target-path = "/soc/serial@7e215040";

        __overlay__ {
            serdev0 = <&td3_uart>;
        };
    };
};