/dts-v1/;
/plugin/;

/ {
    compatible = "brcm,bcm2711";  /* Raspberry Pi 4B */

    fragment@0 {
        target = <&uart0>;        /* Usamos UART0 (ttyAMA0 en tu caso) */
        __overlay__ {
            status = "okay";

            uart_hello: uart_hello {
                compatible = "igmehle,uart_hello";
                status = "okay";
            };
        };
    };
};
