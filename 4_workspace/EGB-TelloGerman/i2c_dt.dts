/dts-v1/;
/plugin/;
/ {
	compatible = "brcm,bcm2835";
	fragment@0 {
		target = <&i2c1>;
		__overlay__ {
			#address-cells = <1>;
			#size-cells = <0>;

			td3_i2c: td3_i2c@15 {
				compatible = "td3_i2c";
				reg = <0x15>;
				status = "okay";
				buffer_size = <128>;
			};
		};
	};
};
